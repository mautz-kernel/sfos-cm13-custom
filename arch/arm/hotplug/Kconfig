## arch/arm/hotplug/Kconfig
```kconfig
config INTELLI_PLUG
        bool "Enable intelli-plug cpu hotplug driver"
        default n
        help
          Generic Intelli-plug cpu hotplug driver for ARM SOCs

comment "Hotplug drivers"

config MSM_HOTPLUG
	bool "Hotplug driver for MSM chipsets"
	depends on MSM_SMP
	help
	  This is a generic hotplug implementation for
	  Qualcomm MSM boards. Use for SMP chipsets only.
	  
config AUTOSMP
	bool "Multi-core automatic hotplug support"
	depends on SMP && HOTPLUG_CPU
	help
	  Automatically hotplugs the multiple cpu cores on and off
	  based on cpu load and suspend state
```
